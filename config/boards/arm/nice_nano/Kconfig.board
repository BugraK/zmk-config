## config/boards/arm/nice_nano/Kconfig.board
```kconfig
config BOARD_NICE_NANO
    bool "nice!nano"
    depends on SOC_NRF52840_QIAA

config BOARD_NICE_NANO_V2
    bool "nice!nano v2"
    depends on SOC_NRF52840_QIAA
```
